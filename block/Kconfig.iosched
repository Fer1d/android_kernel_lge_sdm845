## block/Kconfig.iosched
```kconfig
if BLOCK

menu "IO Schedulers"

config IOSCHED_NOOP
	bool
	default n
	---help---
	  The no-op I/O scheduler is a minimal scheduler that does basic merging
	  and sorting. Its main uses include non-disk based block devices like
	  memory devices, and specialised software or hardware environments
	  that do their own scheduling and require only minimal assistance from
	  the kernel.

config IOSCHED_DEADLINE
	tristate "Deadline I/O scheduler"
	default y
	---help---
	  The deadline I/O scheduler is simple and compact. It will provide
	  CSCAN service with FIFO expiration of requests, switching to
	  a new point in the service tree and doing a batch of IO from there
	  in case of expiry.

config IOSCHED_CFQ
	tristate "CFQ I/O scheduler"
	default y
	---help---
	  The CFQ I/O scheduler tries to distribute bandwidth equally
	  among all processes in the system. It should provide a fair
	  and low latency working environment, suitable for both desktop
	  and server systems.

	  This is the default I/O scheduler.

config IOSCHED_ANXIETY
	tristate "Anxiety I/O scheduler"
	default y
	---help---
	  The Anxiety I/O scheduler prioritizes latency over everything
	  else. It uses a simple algorithm that selects from FIFO queues
	  implemented as doubly linked lists and prioritizes reads over
	  writes.

config CFQ_GROUP_IOSCHED
	bool "CFQ Group Scheduling support"
	depends on IOSCHED_CFQ && BLK_CGROUP
	default n
	---help---
	  Enable group IO scheduling in CFQ.

config IOSCHED_ADIOS
	bool "ADIOS-derived FIFO/batch candidate (experimental)"
	default n
	---help---
	  Optional legacy single-queue FIFO scheduler with bounded per-operation
	  round-robin batches, derived from the Baka ADIOS 4.9 port.
	  This is NOT the complete ADIOS 3.3 adaptive/deadline algorithm:
	  no latency prediction or deadline enforcement is implemented.
	  Host API-mock tests do not establish in-kernel/device correctness.
	  Keep disabled unless explicitly evaluating this isolated candidate.
	  Enabling this alone does not change the default I/O scheduler;
	  select ADIOS in the default scheduler choice to use it at boot.
	  Built-in only: this tree's elevator_init and elevator_switch have
	  inconsistent module-reference ownership on init failure. The private
	  allocation order avoids init double-put, but cannot fix switch's
	  missing put without changing the core. Module support is not offered.

choice
	prompt "Default I/O scheduler"
	default DEFAULT_CFQ
	help
	  Select the I/O scheduler which will be used by default for all
	  block devices.

	config DEFAULT_DEADLINE
		bool "Deadline" if IOSCHED_DEADLINE=y

	config DEFAULT_CFQ
		bool "CFQ" if IOSCHED_CFQ=y

	config DEFAULT_NOOP
		bool "No-op"

	config DEFAULT_ANXIETY
		bool "Anxiety" if IOSCHED_ANXIETY=y

	config DEFAULT_ADIOS
		bool "ADIOS" if IOSCHED_ADIOS=y

endchoice

config DEFAULT_IOSCHED
	string
	default "deadline" if DEFAULT_DEADLINE
	default "cfq" if DEFAULT_CFQ
	default "noop" if DEFAULT_NOOP
	default "anxiety" if DEFAULT_ANXIETY
	default "adios" if DEFAULT_ADIOS

endmenu

endif
```
